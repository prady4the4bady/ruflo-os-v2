## build/iso/buildroot-config/kryos_defconfig
```kconfig
# Prady OS — Buildroot defconfig (x86_64) for v1.0.0
#
# Scope for this release: a minimal, bootable x86_64 live image that
# brings up Linux, systemd, the Prady OS userland mount points, and
# just enough container runtime to pull and start the Docker compose
# stack on first boot.
#
# Everything outside that scope (Xorg, Chromium, PulseAudio, the
# full multimedia stack, etc.) is explicitly NOT baked into the v1.0
# defconfig. Each of those lives in its own follow-up config delta
# to keep this one green against Buildroot 2024.02 and to keep the
# image under 1.5 GB.

BR2_x86_64=y
BR2_X86_CPU_COREI2CORE=y

# Build options
# BR2_CCACHE removed: no persistent cache on GitHub free runners
# BR2_OPTIMIZE_0 used instead of BR2_OPTIMIZE_S to avoid GCC OOM on
# free runners (7 GB RAM, no swap). -Os triggers very high memory
# usage in GCC when compiling large files (e.g. bash, openssh).
BR2_OPTIMIZE_0=y
BR2_JLEVEL=1
# Suppress all compiler warnings from third-party packages.
# These warnings (e.g. -Wdiscarded-qualifiers from bash, -Wnonnull
# from libattr) are noise from upstream sources we do not control.
BR2_TARGET_CFLAGS="-w"
BR2_TARGET_CXXFLAGS="-w"
BR2_HOSTCC_CFLAGS="-w"

# Toolchain: use pre-built Bootlin external toolchain to skip
# compiling glibc from source (avoids glibc-2.38 SSE2 build failure
# on Buildroot 2024.02 internal toolchain).
BR2_TOOLCHAIN_EXTERNAL=y
BR2_TOOLCHAIN_EXTERNAL_BOOTLIN=y
BR2_TOOLCHAIN_EXTERNAL_BOOTLIN_X86_64_GLIBC_STABLE=y
BR2_ENABLE_LOCALE=y
BR2_ENABLE_NLS=y

# System configuration
BR2_TARGET_GENERIC_HOSTNAME="prady-os"
BR2_TARGET_GENERIC_ISSUE="Prady OS v1.0.0"
BR2_INIT_SYSTEMD=y
BR2_SYSTEM_INIT_SYSTEMD=y
BR2_ROOTFS_DEVICE_CREATION_DYNAMIC_EUDEV=y

# Kernel
BR2_LINUX_KERNEL=y
BR2_LINUX_KERNEL_LATEST_VERSION=y
BR2_LINUX_KERNEL_USE_DEFCONFIG=y
BR2_LINUX_KERNEL_DEFCONFIG="x86_64"
BR2_LINUX_KERNEL_BZIMAGE=y

# Root filesystem
BR2_TARGET_ROOTFS_SQUASHFS=y

# System tools
BR2_PACKAGE_BASH=y
BR2_PACKAGE_BUSYBOX=y
BR2_PACKAGE_UTIL_LINUX=y
BR2_PACKAGE_PROCPS_NG=y
BR2_PACKAGE_PSMISC=y
BR2_PACKAGE_E2FSPROGS=y
BR2_PACKAGE_PARTED=y
BR2_PACKAGE_LESS=y
BR2_PACKAGE_FILE=y
BR2_PACKAGE_SUDO=y
BR2_PACKAGE_SHADOW=y
BR2_PACKAGE_VIM=y
BR2_PACKAGE_RSYNC=y
BR2_PACKAGE_HTOP=y

# Network
BR2_PACKAGE_OPENSSH=y
BR2_PACKAGE_OPENSSL=y
BR2_PACKAGE_IPROUTE2=y
BR2_PACKAGE_DHCPCD=y
BR2_PACKAGE_IPTABLES=y
BR2_PACKAGE_NFTABLES=y
BR2_PACKAGE_LIBCURL=y
BR2_PACKAGE_LIBCURL_CURL=y
BR2_PACKAGE_GIT=y

# Python 3 for the systemd-unit bring-up scripts.
BR2_PACKAGE_PYTHON3=y

# Bootloader
BR2_TARGET_GRUB2=y
BR2_TARGET_GRUB2_X86_64_EFI=y
BR2_TARGET_GRUB2_BUILTIN_MODULES_PC="boot linux ext2 fat squash4 part_msdos part_gpt normal biosdisk gfxterm png"
```
